## Config.in
```kconfig
source "$BR2_EXTERNAL_BUILDROOT_SUBMODULE_PATH/package/bm-backend/Config.in"
source "$BR2_EXTERNAL_BUILDROOT_SUBMODULE_PATH/package/bm-frontend/Config.in"
source "$BR2_EXTERNAL_BUILDROOT_SUBMODULE_PATH/package/im-backend/Config.in"
source "$BR2_EXTERNAL_BUILDROOT_SUBMODULE_PATH/package/im-frontend/Config.in"
source "$BR2_EXTERNAL_BUILDROOT_SUBMODULE_PATH/package/dm-backend/Config.in"
source "$BR2_EXTERNAL_BUILDROOT_SUBMODULE_PATH/package/dm-frontend/Config.in"
source "$BR2_EXTERNAL_BUILDROOT_SUBMODULE_PATH/package/dm-monitor/Config.in"
source "$BR2_EXTERNAL_BUILDROOT_SUBMODULE_PATH/package/bm-monitor/Config.in"
source "$BR2_EXTERNAL_BUILDROOT_SUBMODULE_PATH/package/dm-selftest/Config.in"
source "$BR2_EXTERNAL_BUILDROOT_SUBMODULE_PATH/package/mcompat/Config.in"
source "$BR2_EXTERNAL_BUILDROOT_SUBMODULE_PATH/package/python-g19-gpio/Config.in"
source "$BR2_EXTERNAL_BUILDROOT_SUBMODULE_PATH/package/zynq-mkbootimage/Config.in.host"
source "$BR2_EXTERNAL_BUILDROOT_SUBMODULE_PATH/package/cgminer/Config.in"
source "$BR2_EXTERNAL_BUILDROOT_SUBMODULE_PATH/package/cgminer4t4/Config.in"
source "$BR2_EXTERNAL_BUILDROOT_SUBMODULE_PATH/package/sgminer4a11/Config.in"
source "$BR2_EXTERNAL_BUILDROOT_SUBMODULE_PATH/package/sgminer4a12/Config.in"
source "$BR2_EXTERNAL_BUILDROOT_SUBMODULE_PATH/package/sgminer4a7/Config.in"
source "$BR2_EXTERNAL_BUILDROOT_SUBMODULE_PATH/package/cgminer4a6/Config.in"
source "$BR2_EXTERNAL_BUILDROOT_SUBMODULE_PATH/package/bmminer-mix/Config.in"
source "$BR2_EXTERNAL_BUILDROOT_SUBMODULE_PATH/package/ckpool/Config.in"
source "$BR2_EXTERNAL_BUILDROOT_SUBMODULE_PATH/package/wg-diag/Config.in"
```

## antminer_s9/defconfig
```kconfig
BR2_arm=y
BR2_cortex_a9=y
BR2_ARM_ENABLE_NEON=y
BR2_ARM_ENABLE_VFP=y
BR2_CCACHE=y
BR2_CCACHE_DIR="$(BR2_EXTERNAL)/.buildroot-ccache"
BR2_CCACHE_INITIAL_SETUP="--max-size=0 --max-files=0"
BR2_ENABLE_DEBUG=y
BR2_STRIP_EXCLUDE_FILES="cgminer cgminer-api ckpool"
BR2_TOOLCHAIN_BUILDROOT_GLIBC=y
BR2_PACKAGE_HOST_LINUX_HEADERS_CUSTOM_4_14=y
BR2_PACKAGE_HOST_GDB=y
BR2_TARGET_GENERIC_HOSTNAME="dragonAnt"
BR2_TARGET_GENERIC_ISSUE="Welcome to DragonMint"
BR2_TARGET_GENERIC_PASSWD_SHA512=y
BR2_INIT_SYSTEMD=y
BR2_TARGET_GENERIC_ROOT_PASSWD="admin"
BR2_TARGET_GENERIC_GETTY_PORT="ttyPS0"
# BR2_TARGET_GENERIC_REMOUNT_ROOTFS_RW is not set
BR2_SYSTEM_DHCP="eth0"
BR2_ROOTFS_POST_BUILD_SCRIPT="$(BR2_EXTERNAL)/board/bm_xil/post-build.sh"
BR2_ROOTFS_POST_IMAGE_SCRIPT="$(BR2_EXTERNAL)/board/bm_xil/post-image.sh"
BR2_LINUX_KERNEL=y
BR2_LINUX_KERNEL_CUSTOM_GIT=y
BR2_LINUX_KERNEL_CUSTOM_REPO_URL="https://github.com/Xilinx/linux-xlnx.git"
BR2_LINUX_KERNEL_CUSTOM_REPO_VERSION="45f985217d4d31e4e14932cf6266854e0a11b4c2"
BR2_LINUX_KERNEL_PATCH="$(BR2_EXTERNAL)/board/bm_xil/patches/linux"
BR2_LINUX_KERNEL_DEFCONFIG="xilinx_zynq"
BR2_LINUX_KERNEL_CONFIG_FRAGMENT_FILES="$(BR2_EXTERNAL)/board/bm_xil/linux-extras.config"
BR2_LINUX_KERNEL_UIMAGE=y
BR2_LINUX_KERNEL_UIMAGE_LOADADDR="0x8000"
BR2_LINUX_KERNEL_DTS_SUPPORT=y
BR2_LINUX_KERNEL_CUSTOM_DTS_PATH="$(BR2_EXTERNAL)/board/bm_xil/zynq-zc702.dts"
BR2_PACKAGE_BUSYBOX_CONFIG_FRAGMENT_FILES="$(BR2_EXTERNAL)/board/bm_xil/busybox-extras.config"
BR2_PACKAGE_BZIP2=y
BR2_PACKAGE_GZIP=y
BR2_PACKAGE_LZ4=y
BR2_PACKAGE_STRACE=y
BR2_PACKAGE_VALGRIND=y
BR2_PACKAGE_GREP=y
BR2_PACKAGE_MTD=y
BR2_PACKAGE_UBOOT_TOOLS=y
BR2_PACKAGE_UBOOT_TOOLS_DUMPIMAGE=y
BR2_PACKAGE_LUA=y
BR2_PACKAGE_PHP=y
BR2_PACKAGE_PHP_SAPI_FPM=y
# BR2_PACKAGE_PHP_EXT_SESSION is not set
BR2_PACKAGE_PHP_EXT_HASH=y
BR2_PACKAGE_PHP_EXT_JSON=y
BR2_PACKAGE_PHP_EXT_CURL=y
BR2_PACKAGE_PHP_EXT_SOCKETS=y
BR2_PACKAGE_LIBARCHIVE=y
BR2_PACKAGE_LIBARCHIVE_BSDTAR=y
BR2_PACKAGE_LIBARCHIVE_BSDCPIO=y
BR2_PACKAGE_LIBARCHIVE_BSDCAT=y
BR2_PACKAGE_CA_CERTIFICATES=y
BR2_PACKAGE_LIBRESSL=y
BR2_PACKAGE_LIBRESSL_BIN=y
BR2_PACKAGE_LIBCONFIG=y
BR2_PACKAGE_JSON_C=y
BR2_PACKAGE_CURL=y
BR2_PACKAGE_LIBCURL_VERBOSE=y
BR2_PACKAGE_LIBPCAP=y
BR2_PACKAGE_OPENPGM=y
BR2_PACKAGE_NCURSES_WCHAR=y
BR2_PACKAGE_NGINX=y
BR2_PACKAGE_NGINX_HTTP_AUTH_REQUEST_MODULE=y
BR2_PACKAGE_OPENSSH=y
BR2_PACKAGE_WIREGUARD=y
BR2_PACKAGE_SCREEN=y
BR2_PACKAGE_SWUPDATE=y
BR2_PACKAGE_SWUPDATE_CONFIG="$(BR2_EXTERNAL)/board/bm_xil/swupdate.config"
# BR2_PACKAGE_SWUPDATE_INSTALL_WEBSITE is not set
BR2_PACKAGE_SYSTEMD_JOURNAL_GATEWAY=y
BR2_PACKAGE_TAR=y
BR2_PACKAGE_ED=y
BR2_PACKAGE_LESS=y
BR2_PACKAGE_VIM=y
BR2_TARGET_ROOTFS_CPIO=y
BR2_TARGET_ROOTFS_CPIO_XZ=y
BR2_TARGET_ROOTFS_CPIO_UIMAGE=y
BR2_TARGET_ROOTFS_UBI=y
BR2_TARGET_ROOTFS_UBI_SUBSIZE=0
BR2_TARGET_ROOTFS_UBIFS_LEBSIZE=0x1f000
BR2_TARGET_UBOOT=y
BR2_TARGET_UBOOT_BUILD_SYSTEM_KCONFIG=y
BR2_TARGET_UBOOT_CUSTOM_GIT=y
BR2_TARGET_UBOOT_CUSTOM_REPO_URL="https://github.com/Xilinx/u-boot-xlnx.git"
BR2_TARGET_UBOOT_CUSTOM_REPO_VERSION="6d73435ca44ee63c752dbc3576ecc584817addc9"
BR2_TARGET_UBOOT_PATCH="$(BR2_EXTERNAL)/board/bm_xil/patches/uboot"
BR2_TARGET_UBOOT_BOARD_DEFCONFIG="bitmain_antminer_s9"
BR2_TARGET_UBOOT_CONFIG_FRAGMENT_FILES="$(BR2_EXTERNAL)/board/bm_xil/uboot-extras.config"
BR2_TARGET_UBOOT_NEEDS_DTC=y
BR2_TARGET_UBOOT_NEEDS_OPENSSL=y
BR2_TARGET_UBOOT_FORMAT_DTB_IMG=y
BR2_TARGET_UBOOT_FORMAT_IMG=y
BR2_TARGET_UBOOT_FORMAT_ELF=y
BR2_TARGET_UBOOT_SPL=y
BR2_PACKAGE_HOST_DOSFSTOOLS=y
BR2_PACKAGE_HOST_GENIMAGE=y
BR2_PACKAGE_HOST_MTOOLS=y
BR2_PACKAGE_BM_FRONTEND=y
BR2_PACKAGE_BM_MONITOR=y
BR2_PACKAGE_HOST_ZYNQ_MKBOOTIMAGE=y
BR2_PACKAGE_BMMINER_MIX=y
```

## dragonmint_b52/defconfig
```kconfig
BR2_arm=y
BR2_cortex_a9=y
BR2_ARM_ENABLE_NEON=y
BR2_ARM_ENABLE_VFP=y
BR2_CCACHE=y
BR2_CCACHE_DIR="$(BR2_EXTERNAL)/.buildroot-ccache"
BR2_CCACHE_INITIAL_SETUP="--max-size=0 --max-files=0"
BR2_ENABLE_DEBUG=y
BR2_STRIP_EXCLUDE_FILES="cgminer cgminer-api dm-monitor"
BR2_TOOLCHAIN_BUILDROOT_GLIBC=y
BR2_PACKAGE_HOST_LINUX_HEADERS_CUSTOM_4_14=y
BR2_PACKAGE_HOST_GDB=y
BR2_TARGET_GENERIC_HOSTNAME="dragonMint"
BR2_TARGET_GENERIC_ISSUE="Welcome to DragonMint"
BR2_TARGET_GENERIC_PASSWD_SHA512=y
BR2_INIT_SYSTEMD=y
BR2_TARGET_GENERIC_ROOT_PASSWD="admin"
BR2_TARGET_GENERIC_GETTY_PORT="ttyPS0"
# BR2_TARGET_GENERIC_REMOUNT_ROOTFS_RW is not set
BR2_SYSTEM_DHCP="eth0"
BR2_ROOTFS_POST_BUILD_SCRIPT="$(BR2_EXTERNAL)/board/g19/post-build.sh"
BR2_ROOTFS_POST_IMAGE_SCRIPT="$(BR2_EXTERNAL)/board/g19/post-image.sh"
BR2_LINUX_KERNEL=y
BR2_LINUX_KERNEL_CUSTOM_GIT=y
BR2_LINUX_KERNEL_CUSTOM_REPO_URL="https://github.com/Xilinx/linux-xlnx.git"
BR2_LINUX_KERNEL_CUSTOM_REPO_VERSION="15b23f7fa80ed8166af46fb4dd971dbc12d46ad2"
BR2_LINUX_KERNEL_DEFCONFIG="xilinx_zynq"
BR2_LINUX_KERNEL_CONFIG_FRAGMENT_FILES="$(BR2_EXTERNAL)/board/g19/linux-extras.config"
BR2_LINUX_KERNEL_UIMAGE=y
BR2_LINUX_KERNEL_UIMAGE_LOADADDR="0x8000"
BR2_LINUX_KERNEL_DTS_SUPPORT=y
BR2_LINUX_KERNEL_CUSTOM_DTS_PATH="$(BR2_EXTERNAL)/board/g19/zynq-zc702.dts"
BR2_PACKAGE_BUSYBOX_CONFIG_FRAGMENT_FILES="$(BR2_EXTERNAL)/board/g19/busybox-extras.config"
BR2_PACKAGE_BZIP2=y
BR2_PACKAGE_GZIP=y
BR2_PACKAGE_LZ4=y
BR2_PACKAGE_GREP=y
BR2_PACKAGE_MTD=y
BR2_PACKAGE_UBOOT_TOOLS=y
BR2_PACKAGE_UBOOT_TOOLS_DUMPIMAGE=y
BR2_PACKAGE_LUA=y
BR2_PACKAGE_PHP=y
BR2_PACKAGE_PHP_SAPI_FPM=y
# BR2_PACKAGE_PHP_EXT_SESSION is not set
BR2_PACKAGE_PHP_EXT_HASH=y
BR2_PACKAGE_PHP_EXT_JSON=y
BR2_PACKAGE_PHP_EXT_CURL=y
BR2_PACKAGE_PHP_EXT_SOCKETS=y
BR2_PACKAGE_LIBARCHIVE=y
BR2_PACKAGE_LIBARCHIVE_BSDTAR=y
BR2_PACKAGE_LIBARCHIVE_BSDCPIO=y
BR2_PACKAGE_LIBARCHIVE_BSDCAT=y
BR2_PACKAGE_CA_CERTIFICATES=y
BR2_PACKAGE_LIBRESSL=y
BR2_PACKAGE_LIBRESSL_BIN=y
BR2_PACKAGE_LIBCONFIG=y
BR2_PACKAGE_JSON_C=y
BR2_PACKAGE_CURL=y
BR2_PACKAGE_LIBCURL_VERBOSE=y
BR2_PACKAGE_LIBPCAP=y
BR2_PACKAGE_OPENPGM=y
BR2_PACKAGE_NCURSES_WCHAR=y
BR2_PACKAGE_NGINX=y
BR2_PACKAGE_NGINX_HTTP_AUTH_REQUEST_MODULE=y
BR2_PACKAGE_OPENSSH=y
BR2_PACKAGE_SCREEN=y
BR2_PACKAGE_SWUPDATE=y
BR2_PACKAGE_SWUPDATE_CONFIG="$(BR2_EXTERNAL)/board/g19/swupdate.config"
# BR2_PACKAGE_SWUPDATE_INSTALL_WEBSITE is not set
BR2_PACKAGE_SYSTEMD_JOURNAL_GATEWAY=y
BR2_PACKAGE_TAR=y
BR2_PACKAGE_ED=y
BR2_PACKAGE_LESS=y
BR2_PACKAGE_VIM=y
BR2_TARGET_ROOTFS_UBI=y
BR2_TARGET_ROOTFS_UBI_SUBSIZE=0
BR2_TARGET_ROOTFS_UBIFS_LEBSIZE=0x1f000
BR2_TARGET_UBOOT=y
BR2_TARGET_UBOOT_BUILD_SYSTEM_KCONFIG=y
BR2_TARGET_UBOOT_CUSTOM_GIT=y
BR2_TARGET_UBOOT_CUSTOM_REPO_URL="https://github.com/Xilinx/u-boot-xlnx.git"
BR2_TARGET_UBOOT_CUSTOM_REPO_VERSION="5fa7d2ed066166571e969d036c1871c1759a921d"
BR2_TARGET_UBOOT_PATCH="$(BR2_EXTERNAL)/board/g19/patches/uboot"
BR2_TARGET_UBOOT_BOARD_DEFCONFIG="zynq_zc702"
BR2_TARGET_UBOOT_CONFIG_FRAGMENT_FILES="$(BR2_EXTERNAL)/board/g19/uboot-extras.config"
BR2_TARGET_UBOOT_NEEDS_DTC=y
BR2_TARGET_UBOOT_NEEDS_OPENSSL=y
BR2_TARGET_UBOOT_FORMAT_DTB_IMG=y
BR2_TARGET_UBOOT_FORMAT_ELF=y
BR2_TARGET_UBOOT_CUSTOM_DTS_PATH="$(BR2_EXTERNAL)/board/g19/zynq-zc702.dts"
BR2_PACKAGE_HOST_DOSFSTOOLS=y
BR2_PACKAGE_HOST_GENIMAGE=y
BR2_PACKAGE_HOST_MTOOLS=y
BR2_PACKAGE_DM_FRONTEND=y
BR2_PACKAGE_DM_MONITOR=y
BR2_PACKAGE_HOST_ZYNQ_MKBOOTIMAGE=y
BR2_PACKAGE_SGMINER4A12=y
```

## package/bm-backend/Config.in
```kconfig
config BR2_PACKAGE_BM_BACKEND
	bool "bm-backend"
	help
	  AntMiner backend php app
```

## package/bm-frontend/Config.in
```kconfig
config BR2_PACKAGE_BM_FRONTEND
	bool "bm-frontend"
	select BR2_PACKAGE_BM_BACKEND
	help
	  bitmain frontend js app
```

## package/bm-monitor/Config.in
```kconfig
config BR2_PACKAGE_BM_MONITOR
	bool "bm-monitor"
	depends on BR2_arm
	help
	  Antminer monitor daemon
```

## package/bmminer-mix/Config.in
```kconfig
config BR2_PACKAGE_BMMINER_MIX
	bool "bmminer-mix"
	depends on !BR2_PACKAGE_CGMINER
	depends on !BR2_PACKAGE_CGMINER4T4
	depends on !BR2_PACKAGE_SGMINER4A11
	depends on !BR2_PACKAGE_SGMINER4A12
	depends on !BR2_PACKAGE_SGMINER4A7
	depends on !BR2_PACKAGE_CGMINER4A6
	select BR2_PACKAGE_JANSSON
	help
	  This is a multi-threaded multi-pool FPGA and ASIC miner for sia.

	  https://github.com/ckolivas/cgminer

if BR2_PACKAGE_BMMINER_MIX

choice
	prompt "bmminer version"
	default BR2_PACKAGE_BMMINER_MIX_S9
	help
	  Select the bmminer version

config BR2_PACKAGE_BMMINER_MIX_S9
	bool "bmminer s9"

endchoice
endif
```

## package/cgminer/Config.in
```kconfig
config BR2_PACKAGE_CGMINER
	bool "cgminer"
	select BR2_PACKAGE_JANSSON
	help
	  This is a multi-threaded multi-pool FPGA and ASIC miner for bitcoin.

	  https://github.com/ckolivas/cgminer

if BR2_PACKAGE_CGMINER

choice
	prompt "cgminer version"
	default BR2_PACKAGE_CGMINER_T1
	help
	  Select the cgminer version

config BR2_PACKAGE_CGMINER_T1
	bool "cgminer t1"

config BR2_PACKAGE_CGMINER_T2
	bool "cgminer t2"

config BR2_PACKAGE_CGMINER_S9
	bool "cgminer s9"

endchoice
endif
```

## package/cgminer4a6/Config.in
```kconfig
config BR2_PACKAGE_CGMINER4A6
	bool "cgminer4a6"
	depends on !BR2_PACKAGE_CGMINER
	depends on !BR2_PACKAGE_CGMINER4T4
	depends on !BR2_PACKAGE_SGMINER4A11
	depends on !BR2_PACKAGE_SGMINER4A12
	depends on !BR2_PACKAGE_SGMINER4A7
	select BR2_PACKAGE_JANSSON
	select BR2_PACKAGE_MCOMPAT
	help
	  This is a multi-threaded multi-pool FPGA and ASIC miner for sia.

	  https://github.com/ckolivas/cgminer4a7
```

## package/cgminer4t4/Config.in
```kconfig
config BR2_PACKAGE_CGMINER4T4
	bool "cgminer for monroe"
	depends on !BR2_PACKAGE_CGMINER
	select BR2_PACKAGE_JANSSON
	select BR2_PACKAGE_MCOMPAT
	help
	  This is a multi-threaded multi-pool FPGA and ASIC miner for bitcoin.

	  https://github.com/ckolivas/cgminer
```

## package/ckpool/Config.in
```kconfig
config BR2_PACKAGE_CKPOOL
	bool "ckpool"
	help
	  Ultra low overhead massively scalable multi-process, multi-threaded modular bitcoin mining pool, proxy, passthrough, library and database interface in c for Linux.

	  https://bitbucket.org/ckolivas/ckpool
```

## package/dm-backend/Config.in
```kconfig
config BR2_PACKAGE_DM_BACKEND
	bool "dm-backend"
	help
	  dragonmint backend php app
```

## package/dm-frontend/Config.in
```kconfig
config BR2_PACKAGE_DM_FRONTEND
	bool "dm-frontend"
	select BR2_PACKAGE_DM_BACKEND
	help
	  dragonmint frontend js app
```

## package/dm-monitor/Config.in
```kconfig
config BR2_PACKAGE_DM_MONITOR
	bool "dm-monitor"
	depends on BR2_arm
	select BR2_PACKAGE_MCOMPAT
	help
	  Dragonmint monitor daemon
```

## package/dm-selftest/Config.in
```kconfig
config BR2_PACKAGE_DM_SELFTEST
	bool "dm-selftest"
	depends on BR2_arm
	help
	  Dragonmint selftest
```

## package/im-frontend/Config.in
```kconfig
config BR2_PACKAGE_IM_FRONTEND
	bool "im-frontend"
	select BR2_PACKAGE_IM_BACKEND
	help
	  inno frontend js app
```

## package/mcompat/Config.in
```kconfig
config BR2_PACKAGE_MCOMPAT
	bool "MCOMPAT"
	depends on BR2_arm
	help
	  miner compatibility lib
```

## package/python-g19-gpio/Config.in
```kconfig
config BR2_PACKAGE_PYTHON_G19_GPIO
	bool "python-g19-gpio"
	help
	  G19 GPIO Library.
```

## package/sgminer4a11/Config.in
```kconfig
config BR2_PACKAGE_SGMINER4A11
	bool "sgminer4a11"
	depends on !BR2_PACKAGE_CGMINER
	depends on !BR2_PACKAGE_CGMINER4T4
	select BR2_PACKAGE_JANSSON
	select BR2_PACKAGE_MCOMPAT
	help
	  This is a multi-threaded multi-pool FPGA and ASIC miner for decred.

	  https://github.com/ckolivas/sgminer4a11

if BR2_PACKAGE_SGMINER4A11

choice
	prompt "sgminer version"
	default BR2_PACKAGE_SGMINER_B29
	help
	  Select the sgminer version

config BR2_PACKAGE_SGMINER_B29
	bool "sgminer b29"

config BR2_PACKAGE_SGMINER_D9
	bool "sgminer d9"

endchoice
endif
```

## package/sgminer4a12/Config.in
```kconfig
config BR2_PACKAGE_SGMINER4A12
	bool "sgminer4a12"
	depends on !BR2_PACKAGE_CGMINER
	depends on !BR2_PACKAGE_CGMINER4T4
	depends on !BR2_PACKAGE_SGMINER4A11
	select BR2_PACKAGE_JANSSON
	select BR2_PACKAGE_MCOMPAT
	help
	  This is a multi-threaded multi-pool FPGA and ASIC miner for sia.

	  https://github.com/ckolivas/sgminer4a12

if BR2_PACKAGE_SGMINER4A12

choice
	prompt "sgminer version"
	default BR2_PACKAGE_SGMINER_B52
	help
	  Select the sgminer version

config BR2_PACKAGE_SGMINER_B52
	bool "sgminer b52"

config BR2_PACKAGE_SGMINER_S11
	bool "sgminer s11"

endchoice
endif
```

## package/sgminer4a7/Config.in
```kconfig
config BR2_PACKAGE_SGMINER4A7
	bool "sgminer4a7"
	depends on !BR2_PACKAGE_CGMINER
	depends on !BR2_PACKAGE_CGMINER4T4
	depends on !BR2_PACKAGE_SGMINER4A11
	depends on !BR2_PACKAGE_SGMINER4A12
	select BR2_PACKAGE_JANSSON
	select BR2_PACKAGE_MCOMPAT
	help
	  This is a multi-threaded multi-pool FPGA and ASIC miner for sia.

	  https://github.com/ckolivas/sgminer4a7
```

## package/zynq-mkbootimage/Config.in.host
```kconfig
config BR2_PACKAGE_HOST_ZYNQ_MKBOOTIMAGE
	bool "host zynq-mkbootimage"
	depends on BR2_arm
	help
	  This is an open-source replacement for the Xilinx bootgen application.
	  It parses a .bif file and creates a Zynq boot image in .bin format.
	  Currently it supports creating boot image containing fsbl, bitstream,
	  u-boot, and linux related binary files.

	  https://github.com/antmicro/zynq-mkbootimage
```
